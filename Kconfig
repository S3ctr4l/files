## Kconfig
```kconfig
config BOARD_HP_IQ526
	bool "TouchSmart IQ526 (Maureen)"
	select NORTHBRIDGE_INTEL_GM45
	select SOUTHBRIDGE_INTEL_I82801IX
	select BOARD_ROMSIZE_KB_1024
	select HAVE_ACPI_TABLES
	select HAVE_ACPI_RESUME
	select HAVE_OPTION_TABLE
	select HAVE_CMOS_DEFAULT
	# SuperIO TBD after identification
	
if BOARD_HP_IQ526

config MAINBOARD_DIR
	default "hp/iq526"

config MAINBOARD_PART_NUMBER
	default "TouchSmart IQ526"

config MAINBOARD_VENDOR
	default "HP"

config DRAM_RESET_GATE_GPIO
	int
	default 60

config USBDEBUG_HCD_INDEX
	int
	default 1

endif
```

## hp-iq526-verified/src/mainboard/hp/iq526/Kconfig
```kconfig
# SPDX-License-Identifier: GPL-2.0-only

if BOARD_HP_IQ526

config BOARD_SPECIFIC_OPTIONS
	def_bool y
	select BOARD_ROMSIZE_KB_1024
	select EC_ACPI
	select GFX_GMA_PANEL_1_ON_LVDS
	select HAVE_ACPI_RESUME
	select HAVE_ACPI_TABLES
	select INTEL_GMA_HAVE_VBT
	select MAINBOARD_HAS_LIBGFXINIT
	select NORTHBRIDGE_INTEL_GM45
	select SOUTHBRIDGE_INTEL_I82801IX
	select SUPERIO_WINBOND_W83627DHG
	select SYSTEM_TYPE_DESKTOP

config MAINBOARD_DIR
	default "hp/iq526"

config MAINBOARD_PART_NUMBER
	default "TouchSmart IQ526"

config MAINBOARD_VENDOR
	default "HP"

config MAINBOARD_FAMILY
	default "TouchSmart"

config VGA_BIOS_ID
	default "8086,2a42"

config MAX_CPUS
	int
	default 2

config CBFS_SIZE
	default 0x100000

# For NVIDIA dGPU Option ROM (if needed)
config VGA_BIOS_SECOND
	bool
	default n

config VGA_BIOS_SECOND_ID
	string
	default "10de,06e9"

endif # BOARD_HP_IQ526
```
